/dts-v1/;
/plugin/;

/ {
    compatible = "ti,beaglebone", "ti,beaglebone-black", "ti,beaglebone-green";

    fragment@0 {
        target = <&i2c2>;
        __overlay__ {
            status = "okay";
            #address-cells = <1>;
            #size-cells = <0>;
            pcf8591@48 {
                compatible = "nxp,pcf8591";
                reg = <0x48>;
            };
        };
    };
};